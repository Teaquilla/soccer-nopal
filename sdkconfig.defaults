## sdkconfig.defaults
```kconfig
# Target ESP32
CONFIG_IDF_TARGET="esp32"

# Bluetooth Controller Mode (Classic BR/EDR)
CONFIG_BT_ENABLED=y
CONFIG_BTDM_CTRL_MODE_BLE_ONLY=n
CONFIG_BTDM_CTRL_MODE_BR_EDR_ONLY=y
CONFIG_BTDM_CTRL_MODE_BTDM=n

# Bluedroid Host & Classic BT Features
CONFIG_BT_BLUEDROID_ENABLED=y
CONFIG_BT_CLASSIC_ENABLED=y
CONFIG_BT_SPP_ENABLED=y
CONFIG_BT_L2CAP_ENABLED=y
CONFIG_BT_BLE_ENABLED=n

# Custom Partition Table
CONFIG_PARTITION_TABLE_CUSTOM=y
CONFIG_PARTITION_TABLE_CUSTOM_FILENAME="partitions.csv"
CONFIG_PARTITION_TABLE_FILENAME="partitions.csv"

# Flash 4MB, DIO, 80MHz
CONFIG_ESPTOOLPY_FLASHSIZE_4MB=y
CONFIG_ESPTOOLPY_FLASHMODE_DIO=y
CONFIG_ESPTOOLPY_FLASHFREQ_80M=y

# FreeRTOS 1000Hz tick rate
CONFIG_FREERTOS_HZ=1000
```
